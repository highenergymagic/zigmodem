## firmware/boards/sonoff/zbdongle_e/board.yml
```yaml
board:
  name: zbdongle_e
  full_name: SONOFF ZBDongle-E
  vendor: others
  socs:
    - name: efr32mg21a020f1024im32
```

## firmware/boards/sonoff/zbdongle_e/zbdongle_e_defconfig
```kconfig
CONFIG_ARM_MPU=y
CONFIG_FLASH_LOAD_SIZE=0xb4000
CONFIG_SERIAL=y
CONFIG_GPIO=y
CONFIG_FLASH_LOAD_OFFSET=0x4000
CONFIG_FPU=y
CONFIG_UART_ASYNC_API=y
```

## firmware/boards/sonoff/zbdongle_p/board.yml
```yaml
board:
  name: zbdongle_p
  full_name: SONOFF ZBDongle-P
  vendor: others
  socs:
    - name: cc2652p
```

## firmware/boards/sonoff/zbdongle_p/zbdongle_p_defconfig
```kconfig
CONFIG_ARM_MPU=y
CONFIG_FLASH_LOAD_SIZE=0x50000
CONFIG_HW_STACK_PROTECTION=y
CONFIG_GPIO=y
CONFIG_SERIAL=y
CONFIG_CC13X2_CC26X2_BOOTLOADER_ENABLE=y
CONFIG_CC13X2_CC26X2_BOOTLOADER_BACKDOOR_ENABLE=y
CONFIG_CC13X2_CC26X2_BOOTLOADER_BACKDOOR_PIN=15
CONFIG_CC13X2_CC26X2_BOOTLOADER_BACKDOOR_LEVEL=0
```

## west.yml
```yaml
manifest:
  version: "1.2"
  projects:
    - name: zephyr
      url: https://github.com/zephyrproject-rtos/zephyr
      revision: 1179a68cd2d142b2dd93b76101eb24ae335a8e24
      import:
        name-allowlist:
          - cmsis
          - cmsis_6
          - hal_ti
          - hal_silabs
          - picolibc
          - mbedtls
          - tf-psa-crypto
  self:
    path: zigmodem
```
